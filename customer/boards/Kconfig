## customer/boards/Kconfig
```kconfig
#
# Kconfig to support customer boards
#

# Tablet Config Start
	 
config MACH_MESON6_G04
	depends on ARCH_MESON6
	bool "Meson6 g04 board"
	help
	  Support for Amlogic Meson6 g04 customer platform.


config MACH_MESON6_G24
	depends on ARCH_MESON6
	bool "Meson6 g24 board"
	help
	  Support for Amlogic Meson6 g24 customer platform.
config MACH_MESON6_G34
	depends on ARCH_MESON6
	bool "Meson6 86V4 board"
	help
	  Support for Amlogic Meson6 g34 malata customer platform.

config MACH_MESON6_G33_NEW
	depends on ARCH_MESON6
	bool "Meson6 86V4 board"
	help
	  Support for Amlogic Meson6 g33 86V4 customer platform ,which use SDIO WIFI and with HDMI.

	  
config MACH_MESON6_G33_REFAM701
	depends on ARCH_MESON6
	bool "Meson6 86V4 board"
	help
	  Support for Amlogic Meson6 g33 86V4 customer platform ,which use SDIO WIFI and with HDMI.
config MACH_MESON6_G33_1212NEW
	depends on ARCH_MESON6
	bool "Meson6 g33 with AM1212New board"
	help
	  Support for Amlogic Meson6 g33 with AM1212 New customer platform.

config MACH_MESON6_G33_MID7065C
        depends on ARCH_MESON6
        bool "Meson6 g33_MID7065C board"
        help
          Support for Amlogic Meson6 g33 MID7065C customer platform.

config MACH_MESON6_G12_M806A2
	depends on ARCH_MESON6
	bool "Meson6 g12 M806A2 board"
	help
	  Support for Amlogic Meson6 g12 M806A2 customer platform.	  
	  
config MACH_MESON6_G12_M1006A1
	depends on ARCH_MESON6
	bool "Meson6 g12 M1006A1 board"
	help
	  Support for Amlogic Meson6 g12 M1006A1 customer platform.

# Tablet Config End

config MACH_MESON6_G02
  depends on ARCH_MESON6
  bool "Meson6 g02 board"
  help 
    Support for Amlogic Meson6 g02 customer platform.
config MACH_MESON6_G02_DONGLE
  depends on ARCH_MESON6
  bool "Meson6 g02 dongle board"
  help 
    Support for Amlogic Meson6 g02 dongle platform.
config MACH_MESON6_G02_RECOVERY
  depends on ARCH_MESON6
  bool "Meson6 g02 board"
  help 
    Support for Amlogic Meson6 g02 customer platform.
config MACH_MESON6_G02_JB42
  depends on ARCH_MESON6
  bool "Meson6 g02 board"
  help 
    Support for Amlogic Meson6 g02 platform for jb4.2.   
        
config MACH_MESON6_G28
  depends on ARCH_MESON6
  bool "Meson6 g28 board"
  help 
    Support for Amlogic Meson6 g28 customer platform.
    
config MACH_MESON6_G29
  depends on ARCH_MESON6
  bool "Meson6 g29 board"
  help 
    Support for Amlogic Meson6 g29 customer platform.

config MACH_MESON6_G18
  depends on ARCH_MESON6
  bool "Meson6 g18 board"
  help 
    Support for Amlogic Meson6 g18 customer platform.

config MACH_MESON6_G18_RECOVERY
  depends on ARCH_MESON6
  bool "Meson6 g18 board"
  help 
    Support for Amlogic Meson6 g18 customer platform. 
    
config MACH_MESON6_G02_D7
	depends on ARCH_MESON6
	bool "Meson6 g02-d7 board"
	help
	  Support for Amlogic Meson6 g02-d7 customer platform.	  
config MACH_MESON6_G02_D7IS
	depends on ARCH_MESON6
	bool "Meson6 g02-d7is board"
	help
	  Support for Amlogic Meson6 g02-d7is customer platform.	  
config MACH_MESON6_G02_D8
	depends on ARCH_MESON6
	bool "Meson6 g02-d8 board"
	help
	  Support for Amlogic Meson6 g02-d8 customer platform.	  

config MACH_MESON6_G02_TD7100
	depends on ARCH_MESON6
	bool "Meson6 g02-td7100 board"
	help
	  Support for Amlogic Meson6 g02-td7100 customer platform.	

config MACH_MESON6_G02_826DS
	depends on ARCH_MESON6
	bool "Meson6 g02-826ds board"
	help
	  Support for Amlogic Meson6 g02-826ds customer platform.	  
	  
config MACH_MESON6_G02_D9
	depends on ARCH_MESON6
	bool "Meson6 g02 board"
	help
	  Support for Amlogic Meson6 g02_d9 customer platform.
	  	  
config MACH_MESON6_G38
  depends on ARCH_MESON6
  bool "Meson6 g38 board"
  help 
    Support for Amlogic Meson6 g38 customer platform.
    
config MACH_MESON6_G31
  depends on ARCH_MESON6
  bool "Meson6 g31 board"
  help 
    Support for Amlogic Meson6 M6L SOCKET Board.    

config MACH_MESON6_G26_M777ND
       depends on ARCH_MESON6
       bool "Meson6 G26_M777ND board"
       help
         Support for Amlogic Meson6 G26_M777ND customer platform.

config MACH_MESON6_G35
  depends on ARCH_MESON6
  bool "Meson6 g35 board"
  help
    Support for Amlogic Meson6 g35 customer platform.

config MACH_MESON6_G40
  depends on ARCH_MESON6
  bool "Meson6 g40 board"
  help
    Support for Amlogic Meson6 g40 customer platform.

config MACH_MESON6_G38_97203
  depends on ARCH_MESON6
  bool "Meson6 g38_97203 board"
  help 
    Support for Amlogic Meson6 g38_97203 customer platform.

config MACH_MESON6_G38_7203
  depends on ARCH_MESON6
  bool "Meson6 g38_7203 board"
  help 
    Support for Amlogic Meson6 g38_7203 customer platform.
    
    
config MACH_MESON6_G38_10203
  depends on ARCH_MESON6
  bool "Meson6 g38_10203 board"
  help 
    Support for Amlogic Meson6 g38_10203 customer platform.
    
config MACH_MESON6_G19
  depends on ARCH_MESON6
  bool "Meson6 g19 board"
  help
    Support for Amlogic Meson6 g19 customer platform.
    
config MACH_MESON6_G11_E8HDS
	depends on ARCH_MESON6
	bool "Meson6 g11e8hds board"
	help
	  Support for Amlogic Meson6 g11e8hds customer platform.

config MACH_MESON6_G30_N87A_IPS
	depends on ARCH_MESON6
	bool "Meson6 g30 N87A with IPS panel board"
	help
	  Support for Amlogic Meson6 g30 n87a with IPS panel board customer platform
	  
config MACH_MESON6_G20
  depends on ARCH_MESON6
  bool "Meson6 g20 comcast board"
  help 
    Support for Amlogic Meson6 g20 comcast platform.

	  
config MACH_MESON6_G39
	depends on ARCH_MESON6
	bool "Meson6 g39 board"
	help
	  Support for Amlogic Meson6 g39 customer platform.

config MACH_MESON6_G39EMMC7
	depends on ARCH_MESON6
	bool "Meson6 g39emmc7 board"
	help
	  Support for Amlogic Meson6 g39emmc7 customer platform.

config MACH_MESON6_G11_E8HD_EMMC
	depends on ARCH_MESON6
	bool "Meson6 g11e8hd_emmc board"
	help
	  Support for Amlogic Meson6 g11e8hd_emmc customer platform.
	  
config MACH_MESON6_G11_A1002
	depends on ARCH_MESON6
	bool "Meson6 g11 a1002 board"
	help
	  Support for Amlogic Meson6 g11 a1002 customer platform.
config MACH_MESON6_G17_T102
	depends on ARCH_MESON6
	bool "Meson6 g17_t102 board"
	help
	  Support for Amlogic Meson6 g17_t102 customer platform.	  
```

## customer/drivers/touchscreen/Kconfig
```kconfig
#
# Touchscreen driver configuration
#

menuconfig MESON_INPUT_TOUCHSCREEN
	bool "Touchscreens"
	help
	  Say Y here, and a list of supported touchscreens will be displayed.
	  This option doesn't affect the kernel.

	  If unsure, say Y.

if MESON_INPUT_TOUCHSCREEN

config FOCALTECH_CAPACITIVE_TOUCHSCREEN_G06
	tristate "FocalTech I2C capacitive touchscreen for g06"
	depends on I2C
	default n
	help
	  Say Y here if you want to use the FocalTech 5X06 capacitive panel.

config FOCALTECH_CAPACITIVE_TOUCHSCREEN_G06_M777ND
	tristate "FocalTech I2C capacitive touchscreen for M777ND"
	depends on I2C
	default n
	help
	  Say Y here if you want to use the FocalTech 5X06 capacitive panel.
	  
	  
config FOCALTECH_CAPACITIVE_TOUCHSCREEN_G06_1003AC
	tristate "FocalTech I2C capacitive touchscreen for g06 1003AC"
	depends on I2C
	default n
	help
	  Say Y here if you want to use the FocalTech 5606 capacitive panel.	  

config FOCALTECH_CAPACITIVE_TOUCHSCREEN_G12_ANDA_M1005A
	tristate "FocalTech I2C capacitive touchscreen for g12 anda 1024*768 M1005A"
	depends on I2C
	default n
	help
	  Say Y here if you want to use the FocalTech 5X06 capacitive panel.
config FOCALTECH_CAPACITIVE_TOUCHSCREEN_G12_ANDA_M805A
	tristate "FocalTech I2C capacitive touchscreen for g12 anda 1024*768 M805A"
	depends on I2C
	default n
	help
	  Say Y here if you want to use the FocalTech 5X06 capacitive panel.
config GOODIX_GT911_N87A_CAPACITIVE_TOUCHSCREEN
	tristate "Goodix I2C capacitive touchscreen for YUKO n87a 1024x768"
	depends on I2C
	default n
	help
	  Say Y here if you want to use the Goodix GT911 capacitive panel.
config GSl1680_CAPACITIVE_TOUCHSCREEN_G12_ANDA_M702A1
	tristate "gsl1680 I2C capacitive touchscreen for g12 anda 1024*600 M702A1"
	depends on I2C
	default n
	help
	  Say Y here if you want to use the gsl1680 capacitive panel.	
	  
config GSl1680_CAPACITIVE_TOUCHSCREEN_G12_ANDA_M704A1
	tristate "gsl1680 I2C capacitive touchscreen for g12 anda 1280*800 M704A1"
	depends on I2C
	default n
	help
	  Say Y here if you want to use the gsl1680 capacitive panel.
config GSl3680_CAPACITIVE_TOUCHSCREEN_G12_ANDA_M1006A1
	tristate "gsl3680 I2C capacitive touchscreen for g12 anda 1024*768 M1006A1"
	depends on I2C
	default n
	help
	  Say Y here if you want to use the gsl3680 capacitive panel.

config GSl2680_CAPACITIVE_TOUCHSCREEN_G12_ONDA_M806A1
	tristate "gsl2680 I2C capacitive touchscreen for g12 anda 1024*768 M806A1"
		depends on I2C
	default n
	help
	  Say Y here if you want to use the gsl2680 capacitive panel.	

config GSl2680_CAPACITIVE_TOUCHSCREEN_G12_ONDA_M806A2
	tristate "gsl2680 I2C capacitive touchscreen for g12 anda 1024*768 M806A2"
	depends on I2C
	default n
	help
	  Say Y here if you want to use the gsl2680 capacitive panel.	
config GSL1680_CAPACITIVE_TOUCHSCREEN_86V
	tristate "gsl1680 I2C capacitive touchscreen for 86V"
		depends on I2C
	default n
	help
	  Say Y here if you want to use the gsl1680 capacitive panel
	  
config IPS_BD7248F_TOUCHSCREEN
	tristate "IPS_BD7248F touch panel"
	depends on I2C 
	default n
	help
	  Say Y here if you want to use the IPS capacitive panel.
	  
config IPS_BC8601_TOUCHSCREEN
	tristate "IPS_BC8601 for e4 touch panel"
	depends on I2C 
	default n
	help
	  Say Y here if you want to use the IPS capacitive panel.

config GOODIX_GT801_CAPACITIVE_TOUCHSCREEN
	tristate "Goodix GT801 capacitive touchscreen"
	depends on I2C
	default n
	help
	  Say Y here if you want to use the Goodix capacitive panel.
	  
	  To compile this driver as a module, choose M here: the
	  module will be called . 
	  
config GOODIX_GT81X_CAPACITIVE_TOUCHSCREEN
    tristate "Goodix GT81X Capacitive Touch Panel"
	depends on I2C
	default n
	help
	  Say Y here if you want to use the Goodix GT8110 or GT8105 capacitive panel.
	  
	  To compile this driver as a module, choose M here: the
	  module will be called .

config GOODIX_GT810_CAPACITIVE_TOUCHSCREEN
	tristate "Goodix GT810 capacitive touchscreen"
	depends on I2C
	default n
	help
	  Say Y here if you want to use the Goodix capacitive panel.
	  
	  To compile this driver as a module, choose M here: the
	  module will be called . 

config GOODIX_GT9XX_CAPACITIVE_TOUCHSCREEN
	tristate "Goodix GT9XX capacitive touch panel"
	depends on I2C
	default n
	help
	  Say Y here if you want to use the Goodix GT9XX capacitive panel.
	  To compile this driver as a module, choose M here: the
	  module will be called
	  
config EGL_ASD_TOUCHSCREEN
        tristate "Only use for ASD touch panel"
        depends on I2C
        default n
        help
          Say Y here if you want to use the IPS capacitive panel.

config MG8698S_CAPACITIVE_TOUCHSCREEN
	tristate "MG8698S capacitive touch panel"
	depends on I2C
	default n
	help
	  Say Y here if you want to use the MG8698S capacitive panel.

	  To compile this driver as a module, choose M here: the
	  module will be called .

config MG8698S_DISABLE_UPDATE
	tristate "Disable MG8698S firmware Upadate"
	depends on MG8698S_CAPACITIVE_TOUCHSCREEN
	default n
	help
	  Say Y here if you want to dasable the MG8698S firmware update.
	  
config FOCALTECH_CAPACITIVE_TOUCHSCREEN_G24
	tristate "FocalTech I2C capacitive touchscreen for g24"
	depends on I2C
	default n
	help
	  Say Y here if you want to use the FocalTech 5X06 capacitive panel.
	  
config FOCALTECH_5X02_CAPACITIVE_TOUCHSCREEN
	tristate "FocalTech ft5302 I2C capacitive touchscreen"
	depends on I2C
	default n
	help
	  Say Y here if you want to use the FocalTech 5302 capacitive panel	  
	  
config FOCALTECH_CAPACITIVE_TOUCHSCREEN_G05_M76
	tristate "FocalTech I2C capacitive touchscreen for G05_M76"
	depends on I2C
	default n
	help
	  Say Y here if you want to use the FocalTech 5X06 capacitive panel.
	  
config GSl1680E_CAPACITIVE_TOUCHSCREEN_G38_T7203
	tristate "gsl1680e I2C capacitive touchscreen for g38 anda 800*480 T7203"
	depends on I2C
	default n
	help
	  Say Y here if you want to use the gsl1680 capacitive panel.

config GSl3680_CAPACITIVE_TOUCHSCREEN_G17_SKYWORTH_T102
	tristate "gsl3680 I2C capacitive touchscreen for g17 skyworth 1280*800 T102"
	depends on I2C
	default n
	help
	  Say Y here if you want to use the gsl3680 capacitive panel.	
	  	  
	  
config GSl3680_CAPACITIVE_TOUCHSCREEN_G38_T10203
	tristate "gsl3680 I2C capacitive touchscreen for g38_t10203"
		depends on I2C
	default n
	help
	  Say Y here if you want to use the gsl3680 capacitive panel.
config GOODIX_GT811_D7002_CAPACITIVE_TOUCHSCREEN
	tristate "Goodix gt811 capacitive touchscreen for N72A "
	depends on I2C
	default n
	help
	  Say Y here if you want to use the Goodix capacitive panel.

	  To compile this driver as a module, choose M here: the
	  module will be called .	  

config ICN83XX_CAPACITIVE_TOUCHSCREEN
	tristate "icn83xx capacitive touch panel"
	depends on I2C
	default n
	help
	  Say Y here if you want to use the ICN83XX capacitive panel.
	  
	  To compile this driver as a module, choose M here: the
	  module will be called .
	  
endif # MESON_INPUT_TOUCHSCREEN
```

## drivers/amlogic/wifi/rtl8723AS/Kconfig
```kconfig
config RTL8723AS_VAU
	tristate "Realtek 8723A USB WiFi"
	depends on USB
	---help---
	  Help message of RTL8723AS-VAU
```
